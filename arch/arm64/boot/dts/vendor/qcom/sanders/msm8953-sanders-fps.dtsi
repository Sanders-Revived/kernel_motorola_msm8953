/* adapted from MotorolaMobilityLLC/kernel-msm oreo-8.1.0-release-sanders
 * msm8953-sanders-fps.dtsi. spi controller/clocks/pins from stock dt;
 * regulator supplies added (1.8V pm8953_l6, driver requires
 * vdd_ana/vcc_spi/vdd_io).
 */

#include <dt-bindings/interrupt-controller/irq.h>

&soc {
	spi_8: spi@7af8000 { /* BLSP2 QUP3 */
		compatible = "qcom,spi-qup-v2";
		status = "okay";
		#address-cells = <1>;
		#size-cells = <0>;
		reg-names = "spi_physical";
		reg = <0x07af8000 0x600>;
		interrupt-names = "spi_irq";
		interrupts = <0 302 IRQ_TYPE_LEVEL_HIGH>;
		spi-max-frequency = <19200000>;

		pinctrl-names = "spi_default", "spi_sleep";
		pinctrl-0 = <&spi_8_active>;
		pinctrl-1 = <&spi_8_sleep>;
		qcom,infinite-mode = <0>;
		qcom,master-id = <84>;
		qcom,use-pinctrl;

		fpc_fpc1020@0 {
			compatible = "fpc,fpc1020";
			reg = <0>;
			interrupt-parent = <&tlmm>;
			interrupts = <48 0x0>;
			spi-max-frequency = <4800000>;
			fpc,gpio_irq = <&tlmm 48 0>;
			fpc,gpio_rst = <&tlmm 140 0>;
			vdd_ana-supply = <&pm8953_l6>;
			vcc_spi-supply = <&pm8953_l6>;
			vdd_io-supply = <&pm8953_l6>;
			pinctrl-names = "default", "suspend";
			pinctrl-0 = <&rst_active &int_active &ldo_en_active &id_default>;
			pinctrl-1 = <&rst_suspend &int_suspend &ldo_en_suspend &id_default>;
			fpc,txout_boost_enable;
			clock-names = "iface_clk", "core_clk";
			clocks = <&clock_gcc clk_gcc_blsp2_ahb_clk>,
				<&clock_gcc clk_gcc_blsp2_qup4_spi_apps_clk>;
		};
	};
};
