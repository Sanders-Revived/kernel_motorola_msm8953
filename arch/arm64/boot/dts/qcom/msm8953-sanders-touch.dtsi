/* FT5436 touch on blsp1-qup3, adapted from
 * MotorolaMobilityLLC/kernel-msm oreo-8.1.0-release-sanders
 * msm8953-sanders.dtsi. compatible and property names follow the
 * imren focaltech_touch driver (focaltech,fts_ts).
 */

&i2c_3 {
	status = "okay";
	qcom,disable-dma;

	focaltech_ts@38 {
		compatible = "focaltech,fts_ts";
		reg = <0x38>;
		interrupt-parent = <&tlmm>;
		interrupts = <65 IRQ_TYPE_EDGE_FALLING>;
		vdd-supply = <&pm8953_l10>;
		vcc_i2c-supply = <&pm8953_l5>;
		focaltech,name = "ft5436";
		focaltech,family-id = <0x54>;
		focaltech,reset-gpio = <&tlmm 64 0>;
		focaltech,irq-gpio = <&tlmm 65 0>;
		focaltech,display-coords = <0 0 1080 1920>;
		focaltech,panel-coords = <0 0 1080 1920>;
		focaltech,max-touch-number = <10>;
		pinctrl-names = "pmx_ts_active", "pmx_ts_suspend", "pmx_ts_release";
		pinctrl-0 = <&pmx_ts_active>;
		pinctrl-1 = <&pmx_ts_suspend>;
		pinctrl-2 = <&pmx_ts_release>;
	};
};
