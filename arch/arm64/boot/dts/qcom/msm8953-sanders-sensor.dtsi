&soc {
	liteon@23 {
		compatible = "liteon,ltr559";
		reg = <0x23>;
		pinctrl-names = "default","sleep";
		pinctrl-0 = <&ltr559_default>;
		pinctrl-1 = <&ltr559_sleep>;
		interrupt-parent = <&tlmm>;
		interrupts = <86 0x2>;
		vdd-supply = <&pm8953_l10>;
		vio-supply = <&pm8953_l6>;
		ltr,irq-gpio = <&tlmm 86 0x2>;
		ltr,ps-threshold = <800>;
		ltr,ps-hysteresis-threshold = <300>;
		ltr,ps-nearoffset = <20>;
		ltr,ps-faroffset = <15>;
		ltr,als-polling-time = <200>;
		ltr,prox-sensor-name = "Rear Proximity sensor";
	};
};
