/* Copyright (c) 2016, Motorola Mobility Inc. All rights reserved. */

/dts-v1/;

#include "msm8953.dtsi"
#include "pmi8950.dtsi"
#include "msm8953-pmi8950.dtsi"
#include "msm8953-qrd-sku3.dtsi"
#include "msm8953-mdss-panels.dtsi"
#include "msm8953-sanders-display.dtsi"
#include "msm8953-sanders-battery.dtsi"
#include "msm8953-sanders-pmic.dtsi"
#include "msm8953-sanders-regulator.dtsi"
#include "msm8953-sanders-sdhc.dtsi"
#include "msm8953-sanders-debug.dtsi"
#include "msm8953-sanders-pinctrl.dtsi"
#include "msm8953-sanders-fps.dtsi"
#include "msm8953-sanders-touch.dtsi"
#include "msm8953-sanders-usb.dtsi"
#include "msm8953-sanders-misc.dtsi"
#include "msm8953-sanders-sensor.dtsi"
#include "msm8953-sanders-vibrator.dtsi"
#include "msm8953-sanders-soc.dtsi"
#include "msm8953-sanders-android.dtsi"
#include "msm8953-sanders-nfc.dtsi"
#include "msm8953-sanders-camera.dtsi"
#include "msm8953-sanders-audio.dtsi"
#include "msm8953-sanders-carrier.dtsi"

/ {
	model = "Motorola Moto G5S Plus";
	compatible = "qcom,msm8953-sanders", "qcom,msm8953-moto",
		"qcom,msm8953";
	qcom,board-id = <0x4B 0x8400>,<0x4C 0x8400>;
};
