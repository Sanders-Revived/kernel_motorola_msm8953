/* Copyright (c) 2016, Motorola Mobility Inc. All rights reserved. */

/dts-v1/;

#include "msm8953.dtsi"
#include "pmi8950.dtsi"
#include "msm8953-pmi8950.dtsi"
#include "msm8953-qrd-sku3.dtsi"
#include "msm8953-mdss-panels.dtsi"
#include "msm8953-sanders-display.dtsi"
#include "msm8953-sanders-battery.dtsi"
#include "msm8953-sanders-pmic.dtsi"
#include "msm8953-sanders-regulator.dtsi"
#include "msm8953-sanders-sdhc.dtsi"
#include "msm8953-sanders-debug.dtsi"
#include "msm8953-sanders-pinctrl.dtsi"
#include "msm8953-sanders-fps.dtsi"
#include "msm8953-sanders-touch.dtsi"

/ {
	model = "Motorola Moto G5S Plus";
	compatible = "qcom,msm8953-sanders", "qcom,msm8953-moto",
		"qcom,msm8953";
	qcom,board-id = <0x4B 0x8200>;
};
